// SPDX-License-Identifier: (GPL-2.0-or-later OR BSD-3-Clause)
/*
 * Copyright (C) 2024 Lothar Waßmann <LW@KARO-electronics.de>
 */

#include "stm32mp153a-karo-scmi.dtsi"
#include "stm32mp153-qsmp.dtsi"

&gpioz {
	clocks = <&scmi_clk CK_SCMI_GPIOZ>;
};
